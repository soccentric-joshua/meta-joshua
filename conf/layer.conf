## conf/layer.conf
```bitbake
BBPATH .= ":${LAYERDIR}"

BBFILES += " \
    ${LAYERDIR}/recipes-*/*/*.bb \
    ${LAYERDIR}/recipes-*/*/*.bbappend \
"

BBFILE_COLLECTIONS += "meta-joshua"
BBFILE_PATTERN_meta-joshua = "^${LAYERDIR}/"
BBFILE_PRIORITY_meta-joshua = "10"

LAYERDEPENDS_meta-joshua = "core meta-ti-bsp"
LAYERSERIES_COMPAT_meta-joshua = "scarthgap"
```
